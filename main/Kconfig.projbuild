## main/Kconfig.projbuild
```kconfig
menu "VCU Configuration"
    menu "CAN"
        config PREVCU_CAN_TIMEOUT
            int "Timeout (ms)"
            range 0 10000
            default 100
    endmenu

    menu "Car Parameters"
        config PREVCU_HALF_WHEELBASE_MM
            int "Half Wheelbase (mm)"
            range 0 10000
            default 500
        config PREVCU_WHEEL_RADIUS_MM
            int "Wheel Radius (mm)"
            range 0 10000
            default 406
    endmenu
    menu "GPIO"
        config PREVCU_GPIO_MOSI
            int "GPIO MOSI"
            range 0 48
            default 23
            help
                MOSI Pin

        config PREVCU_GPIO_MISO
            int "GPIO MISO"
            range 0 48
            default 19
            help
                MISO Pin

        config PREVCU_GPIO_SCLK
            int "GPIO SCLK"
            range 0 48
            default 18
            help
                SCLK Pin

        config PREVCU_GPIO_CS_ADC
            int "GPIO ADC CS"
            range 0 48
            default 18
            help
                Chip Select Pin for ADC

        config PREVCU_GPIO_CS_ACCEL
            int "GPIO Accelerometer CS"
            range 0 48
            default 20
            help
                Chip Select Pin for Accelerometer

        config PREVCU_GPIO_CS_GYRO
            int "GPIO Gyroscope CS"
            range 0 48
            default 21
            help
                Chip Select Pin for Gyroscope

        config PREVCU_ACCEL_INT_GPIO
            int "Accelerometer Interupt Number"
            range 0 48
            default 26
            help
                Which pin of the ESP32 is connected to the Accelerometer interupt pin

        config PREVCU_GYRO_INT_GPIO
            int "Gyroscope Interupt GPIO"
            range 0 48
            default 25
            help
                Which pin of the ESP32 is connected to the gyrscope interupt pin

        config PREVCU_CANTX_GPIO
            int "CAN Tx GPIO"
            range 0 48
            default 21
        config PREVCU_CANRX_GPIO
            int "CAN Rx GPIO"
            range 0 48
            default 22

        config PREVCU_GPIO_SAS_TX
            int "SAS UART Tx GPIO"
            range 0 48
            default 26
        config PREVCU_GPIO_SAS_RX
            int "SAS UART Rx GPIO"
            range 0 48
            default 27
    endmenu

    menu "Gyroscope"
        config PREVCU_GYRO_FULL_SCALE
            int "Gyroscope Full Scale"
            range 0 4
            default 2
            help
                0 => 2000, 1 => 1000, 2 => 500, 3 => 250, 4 => 125 (deg/s)

        config PREVCU_GYRO_ODR
            int "Gyroscope Output Data Rate"
            range 0 7
            default 2
            help
                0 => 2000, 1 => 2000, 2 => 1000, 3 => 400, 4 => 200, 5 => 100, 6 => 200, 7 => 100

        config PREVCU_GYRO_INT
            int "Gyroscope Interupt Number"
            range 3 4
            default 3
            help
                Which internal interupt of the BMI to use

        config PREVCU_GYRO_INT_TYPE
            int "Gyroscope Interupt Type"
            range 0 1
            default 1
            help
                0 => push-pull 1 => open-drain
    endmenu

    menu "Accelerometer"
        config PREVCU_ACCEL_INT
            int "Accelerometer Interupt Number"
            range 1 2
            default 1
            help
                Which internal interupt of the BMI to use

        config PREVCU_ACCEL_FULL_SCALE
            int "Accelerometer Full Scale"
            range 0 3
            default 1
            help
                0 => 3, 1 => 6, 2 => 12, 3 => 24 (g)

        config PREVCU_ACCEL_OVERSAMPLING
            int "Accelerometer Oversampling"
            range 8 10
            default 9
            help
                8 => 4x, 9 => 2x, 10 => 1x

        config PREVCU_ACCEL_ODR
            int "Accelerometer Output Data Rate"
            range 5 12
            default 11
            help
                5 => 12.5, 6 => 25, 7 => 50, 8 => 100, 9 => 200, 10 => 400, 11 => 800, 12 => 1600 (Hz)

        config PREVCU_ACCEL_INT_TYPE
            int "Accelerometer Interupt Type"
            range 0 1
            default 1
            help
                0 => push-pull 1 => open-drain
    endmenu

    menu "Throttle"
        config PREVCU_SLIP_THOUSANDS
            int "Max Slip Ratio * 1000"
            range 0 1000
            default 110
        config PREVCU_MAX_THROTTLE_PERCENT
            int "100% Throttle in % of 5V"
            range 0 5000
            default 32
        config PREVCU_MIN_THROTTLE_PERCENT
            int "0% Throttle in % of 5V"
            range 0 100
            default 10
        config PREVCU_ERR_MAX_THROTTLE_PERCENT
            int "Error High Throttle % of 5V"
            range 0 100
            default 90
        config PREVCU_ERR_MIN_THROTTLE_PERCENT
            int "Error Low Throttle % of 5V"
            range 0 100
            default 6
        config PREVCU_THROTTLE_ADC_NUM
            int "Throttle ADC Number"
            range 0 7
            default 4
    endmenu

    menu "SAS"
        config PREVCU_SAS_FORWARD
            int "Straight Steering Wheel Count"
            range 0 4095
            default 0
    endmenu

    menu "Motor Controller Addresses"
        config PREVCU_FL_ADDR
            int "Front Left Node-ID"
            range 1 255
            default 1
        config PREVCU_FR_ADDR
            int "Front Right Node-ID"
            range 1 255
            default 2
        config PREVCU_BL_ADDR
            int "Back Left Node-ID"
            range 1 255
            default 3
        config PREVCU_BR_ADDR
            int "Back Right Node-ID"
            range 1 255
            default 4
    endmenu

    menu "Motor Temperatures"
        config PREVCU_FL_ADC_NUM
            int "Front Right ADC Address"
            range 0 7
            default 0
        config PREVCU_FL_PULLDOWN
            int "Front Left Pulldown Resistor"
            range 0 1000000
            default 1200
        config PREVCU_FR_ADC_NUM
            int "Front Right ADC Address"
            range 0 7
            default 1
        config PREVCU_FR_PULLDOWN
            int "Front Left Pulldown Resistor"
            range 0 1000000
            default 1200
        config PREVCU_BL_ADC_NUM
            int "Front Right ADC Address"
            range 0 7
            default 2
        config PREVCU_BL_PULLDOWN
            int "Front Left Pulldown Resistor"
            range 0 1000000
            default 1200
        config PREVCU_BR_ADC_NUM
            int "Front Right ADC Address"
            range 0 7
            default 3
        config PREVCU_BR_PULLDOWN
            int "Front Left Pulldown Resistor"
            range 0 1000000
            default 1200
    endmenu

    menu "Priorities"
        config PREVCU_RECEIVE_CAN_PRIORITY
            int "Receive Can Interupt Priority"
            range 1 32
            default 9
            help
                Should be the highest
        config PREVCU_SEND_TORQUES_PRIORITY
            int "Send Torque Priority"
            range 1 32
            default 8

        config PREVCU_READ_THROTTLE_PRIORITY
            int "Read Throttle Priority"
            range 1 32
            default 7

        config PREVCU_READ_ACCEL_PRIORITY
            int "Read Accelerometer Priority"
            range 1 32
            default 6

        config PREVCU_READ_SPEEDS_PRIORITY
            int "Read Motor Speeds Priority"
            range 1 32
            default 5

        config PREVCU_READ_MOTOR_TORQUES_PRIORITY
            int "Read Motor Torque Priority"
            range 1 32
            default 4

        config PREVCU_READ_GYRO_PRIORITY
            int "Read Gyroscope Priority"
            range 1 32
            default 3

        config PREVCU_READ_CONTROLLER_TEMPS_PRIORITY
            int "Read Motor Controller Temperature Priority"
            range 1 32
            default 2

        config PREVCU_READ_SAS_PRIORITY
            int "Read Steering Angle Sensor Priority"
            range 1 32
            default 1
    endmenu

    menu "Task Periods"
        config PREVCU_SEND_TORQUES_PERIOD
            int "Send Torque Period"
            range 1 10000
            default 20
            help
                rate in milliseconds

        config PREVCU_READ_THROTTLE_PERIOD
            int "Read Throttle Period"
            range 1 10000
            default 10
            help
                rate in milliseconds

        config PREVCU_READ_SPEEDS_PERIOD
            int "Read Motor Speeds Period"
            range 1 10000
            default 20
            help
                rate in milliseconds

        config PREVCU_READ_MOTOR_TORQUES_PERIOD
            int "Read Motor Torque Period"
            range 1 10000
            default 20
            help
                rate in milliseconds

        config PREVCU_READ_MOTOR_TEMPS_PERIOD
            int "Read Motor Temperature Period"
            range 1 10000
            default 1000
            help
                rate in milliseconds

        config PREVCU_READ_CONTROLLER_TEMPS_PERIOD
            int "Read Motor Controller Temperature Period (rounded up to throttle multiple)"
            range 1 10000
            default 1000
            help
                rate in milliseconds

        config PREVCU_READ_SAS_PERIOD
            int "Read Steering Angle Sensor Period"
            range 1 10000
            default 100
            help
                rate in milliseconds
    endmenu

endmenu
```
